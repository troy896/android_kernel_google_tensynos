## drivers/rekernel/Kconfig
```kconfig
menu "Re:Kernel"

config REKERNEL
	bool "Re:Kernel support"
	default y
	help
	  Re:Kernel v10.0 - Tombstone experience improvement.
	  Detects binder/signal events targeting frozen processes
	  and notifies userspace via netlink.

config REKERNEL_NETWORK
	bool "Re:Kernel NetReceive unfreeze support"
	depends on REKERNEL
	default n
	help
	  Allow ReKernel to monitor network activity for frozen apps.
endmenu
```
